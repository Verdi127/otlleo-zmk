#include <input/processors.dtsi>
#include <dt-bindings/zmk/input_transform.h>

&trackball_listener {
    /* base processor chain on all layers */
    input-processors = <&zip_xy_scaler 5 5>, <&zip_temp_layer 4 500>;

    /* layer-6 pointer/scroll override */
    scroller: scroller {
        layers           = <6>;
        input-processors = <
            &zip_xy_scaler 1 15                              // Scales the scroll speed
            &zip_xy_to_scroll_mapper                         // Converts XY movement to scroll events
            &zip_scroll_transform (INPUT_TRANSFORM_Y_INVERT) // Inverts the scroll direction
        >;
    };

    /* layer-7 slow-pointer override */
    slow_pointer: slow_pointer {
        layers           = <5>;
        input-processors = <&zip_xy_scaler 2 6>;
    };
};
