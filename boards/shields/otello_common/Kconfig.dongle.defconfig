## boards/shields/otello_common/Kconfig.dongle.defconfig
```kconfig
if SHIELD_otello_DONGLE

config ZMK_KEYBOARD_NAME
	default "otello"

config ZMK_SPLIT_ROLE_CENTRAL
	default y

endif

if SHIELD_otello_DONGLE_LEFT

config ZMK_KEYBOARD_NAME
	default "otello_left"

endif

if SHIELD_otello_DONGLE_RIGHT

config ZMK_KEYBOARD_NAME
	default "otello_right"

endif

if SHIELD_otello_DONGLE_LEFT || SHIELD_otello_DONGLE_RIGHT || SHIELD_otello_DONGLE

config ZMK_SPLIT
	default y

endif
```

## boards/shields/otello_common/Kconfig.reset.defconfig
```kconfig
if SHIELD_RESET

config ZMK_KEYBOARD_NAME
	default "otello Reset"

config SETTINGS
	default y

config ZMK_SETTINGS_RESET_ON_START
	default y

config ZMK_BLE
	default n

config ZMK_DISPLAY
	default n

endif
```

## boards/shields/otello_left_dongle/Kconfig.shield
```kconfig
config SHIELD_otello_DONGLE_LEFT
	def_bool $(shields_list_contains,otello_left_dongle)
```

## boards/shields/otello_right_dongle/Kconfig.shield
```kconfig
config SHIELD_otello_DONGLE_RIGHT
	def_bool $(shields_list_contains,otello_right_dongle)
```

## config/west.yml
```yaml
manifest:
  remotes:
    - name: zmkfirmware
      url-base: https://github.com/zmkfirmware
    - name: kumamuk-git
      url-base: https://github.com/kumamuk-git
    - name: englmaxi
      url-base: https://github.com/englmaxi

  projects:
    - name: zmk
      remote: zmkfirmware
      revision: main
      import: app/west.yml
    - name: zmk-dongle-display
      remote: englmaxi
      revision: main

  self:
    path: config
```
